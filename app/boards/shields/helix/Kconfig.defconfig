## app/boards/shields/helix/Kconfig.defconfig
```kconfig
if SHIELD_HELIX_LEFT

config ZMK_KEYBOARD_NAME
	default "Helix Left"

endif


if SHIELD_HELIX_RIGHT

config ZMK_KEYBOARD_NAME
	default "Helix Right"

endif

if SHIELD_HELIX_LEFT || SHIELD_HELIX_RIGHT

config ZMK_SPLIT
  default y

endif
```
